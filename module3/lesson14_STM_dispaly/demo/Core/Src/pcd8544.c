/**
 * @file    pcd8544.c
 * @brief   PCD8544 (Nokia 5110) LCD driver - implementation
 *
 * Lesson 14 - Fundamentals of C++ for Microcontrollers
 */

#include "pcd8544.h"
#include <string.h>   /* memset */

/* -- Internal state --------------------------------------------- */
static SPI_HandleTypeDef *_hspi = NULL;

/* -- 5x7 ASCII bitmap font (characters 0x20 to 0x7E) ----------- *
 * Each entry = 5 bytes, one byte per column.                      *
 * Bit 0 = top pixel, bit 6 = bottom pixel of the 7-row glyph.    *
 * ---------------------------------------------------------------- */
static const uint8_t font5x7[][5] = {
    { 0x00, 0x00, 0x00, 0x00, 0x00 }, /* ' ' 0x20 */
    { 0x00, 0x00, 0x5F, 0x00, 0x00 }, /* '!' 0x21 */
    { 0x00, 0x07, 0x00, 0x07, 0x00 }, /* '"' 0x22 */
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    { 0x10, 0x08, 0x08, 0x10, 0x08 }, /* '~' 0x7E */
};

/* -- Internal helpers ------------------------------------------- */

void lcd_send_byte(uint8_t data, uint8_t is_data)
{
    /* DC pin: HIGH = data, LOW = command */
    HAL_GPIO_WritePin(LCD_DC_PORT, LCD_DC_PIN,
                      is_data ? GPIO_PIN_SET : GPIO_PIN_RESET);
    /* Assert chip-enable (active-low) */
    HAL_GPIO_WritePin(LCD_CE_PORT, LCD_CE_PIN, GPIO_PIN_RESET);
    /* Blocking SPI transmit */
    HAL_SPI_Transmit(_hspi, &data, 1, HAL_MAX_DELAY);
    /* Release chip-enable */
    HAL_GPIO_WritePin(LCD_CE_PORT, LCD_CE_PIN, GPIO_PIN_SET);
}

static void lcd_cmd(uint8_t cmd)
{
    lcd_send_byte(cmd, 0);
}

/* -- Public API ------------------------------------------------- */

void lcd_init(SPI_HandleTypeDef *hspi, uint8_t vop)
{
    _hspi = hspi;

    /* Hardware reset: pulse RST low for >= 100 ns              */
    HAL_GPIO_WritePin(LCD_RST_PORT, LCD_RST_PIN, GPIO_PIN_RESET);
    HAL_Delay(1);
    HAL_GPIO_WritePin(LCD_RST_PORT, LCD_RST_PIN, GPIO_PIN_SET);

    /* De-assert CE while we configure */
    HAL_GPIO_WritePin(LCD_CE_PORT, LCD_CE_PIN, GPIO_PIN_SET);

    /* Extended command set (H=1) */
    lcd_cmd(0x21);          /* Function set: PD=0, V=0, H=1      */
    lcd_cmd(vop);           /* Set Vop (contrast): 0xB0..0xBF     */
    lcd_cmd(0x04);          /* Temperature coefficient Tc=0        */
    lcd_cmd(0x14);          /* Bias system 1:48                    */

    /* Basic command set (H=0) */
    lcd_cmd(0x20);          /* Function set: PD=0, V=0, H=0       */
    lcd_cmd(0x0C);          /* Display control: normal mode        */

    lcd_clear();
}

void lcd_clear(void)
{
    /* Reset cursor to origin */
    lcd_cmd(0x80);   /* X address = 0 */
    lcd_cmd(0x40);   /* Y address = 0 */

    /* Write 504 zero bytes (all pixels off) */
    for (uint16_t i = 0; i < LCD_BUF_SIZE; i++) {
        lcd_send_byte(0x00, 1);
    }

    /* Reset cursor again after clear */
    lcd_cmd(0x80);
    lcd_cmd(0x40);
}

void lcd_goto(uint8_t col, uint8_t bank)
{
    if (col  >= LCD_COLS)  col  = 0;
    if (bank >= LCD_BANKS) bank = 0;
    lcd_cmd(0x80 | col);   /* Set X address */
    lcd_cmd(0x40 | bank);  /* Set Y address */
}

void lcd_print_char(char c)
{
    /* Clamp to printable range */
    if (c < 0x20 || c > 0x7E) c = '?';

    uint8_t idx = (uint8_t)(c - 0x20);

    /* 5 data bytes from font table */
    for (uint8_t col = 0; col < 5; col++) {
        lcd_send_byte(font5x7[idx][col], 1);
    }
    /* 1 spacer byte */
    lcd_send_byte(0x00, 1);
}

void lcd_print_string(const char *str)
{
    while (*str) {
        lcd_print_char(*str++);
    }
}
